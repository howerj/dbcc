VERSION ""

NS_ :

BS_:

BU_: Vector__XXX

BO_ 1682 extended_multiplex: 8 Vector__XXX
 SG_ sig1 : 0|2@1+ (1,0) [0|0] "" Vector__XXX
 SG_ sig2 : 2|2@1+ (-1,4) [0|4] "" Vector__XXX
 SG_ sig3 : 4|4@1+ (1,0) [0|0] "" Vector__XXX
 SG_ simple_muxer M : 8|16@1+ (1,0) [0|0] "" Vector__XXX
 SG_ muxed_muxer m9216M : 24|8@1+ (1,0) [0|0] "" Vector__XXX
 SG_ muxed1 m1 : 32|32@1+ (1,0) [0|0] "" Vector__XXX
 SG_ muxed2 m4 : 32|32@1+ (1,0) [0|0] "" Vector__XXX

SG_MUL_VAL_ 1682 muxed_muxer simple_muxer 9216-9216;
SG_MUL_VAL_ 1682 muxed1 muxed_muxer 1-1;
SG_MUL_VAL_ 1682 muxed2 muxed_muxer 4-4;
